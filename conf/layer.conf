## conf/layer.conf
```bitbake
# We have a conf and classes directory, add to BBPATH
BBPATH .= ":${LAYERDIR}"

# We have recipes-* directories, add to BBFILES
BBFILES += "${LAYERDIR}/recipes-*/*/*.bb \
            ${LAYERDIR}/recipes-*/*/*.bbappend"

BBFILE_COLLECTIONS += "meta-sl77-dk2"
BBFILE_PATTERN_meta-sl77-dk2 = "^${LAYERDIR}/"
BBFILE_PRIORITY_meta-sl77-dk2 = "7"

LAYERDEPENDS_meta-sl77-dk2 = "core"
LAYERSERIES_COMPAT_meta-sl77-dk2 = "kirkstone"
```
